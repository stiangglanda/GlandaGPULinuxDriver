## Kconfig
```kconfig
config DRM_GLANDA
	tristate "GlandaGPU DRM driver"
	depends on DRM && MMU && (PCI || COMPILE_TEST)
	depends on DRM
	select DRM_KMS_HELPER
	select DRM_GEM_SHMEM_HELPER
	help
	  DRM/KMS driver for the GlandaGPU display controller
	  (FPGA soft IP). This driver supports basic modesetting,
	  dumb buffers, and atomic updates via shadow planes.
	  It also provides PCI probing for QEMU testing.
```
